#include <stdio.h>
#include <string.h>
#include <stdlib.h>
#include "freertos/FreeRTOS.h"
#include "freertos/task.h"
#include "esp_timer.h"
#include "esp_lcd_panel_io.h"
#include "esp_lcd_panel_vendor.h"
#include "esp_lcd_panel_ops.h"
#include "driver/gpio.h"
#include "driver/spi_master.h"
#include "esp_err.h"
#include "esp_log.h"
#include "nvs_flash.h"
#include "esp_ieee802154.h"
#include "esp_lcd_st7735.h"
#include "esp_heap_caps.h"

#define TFT_RST    (1)
#define TFT_DC     (2)
#define TFT_CS     (3)
#define TFT_SCLK   (19)
#define TFT_MOSI   (18)

#define LCD_WIDTH  128
#define LCD_HEIGHT 160

static const char *TAG = "main";
static esp_lcd_panel_handle_t panel_handle = NULL;

/* ============================================================
   Variabile radio ÔÇö volatile pentru acces ISR-safe
   ============================================================ */
static volatile uint32_t ieee802154_frame_count = 0;
static volatile int8_t   last_rssi = 0;
static volatile uint8_t  last_lqi = 0;
static volatile uint8_t  last_rx_channel = 11;
static volatile uint8_t  current_channel = 11;

/* ============================================================
   FONT 8x8 ÔÇö ASCII 32..122
   ============================================================ */
const uint8_t font8x8[91][8] = {
    {0x00,0x00,0x00,0x00,0x00,0x00,0x00,0x00}, // sp
    {0x18,0x3C,0x3C,0x18,0x18,0x00,0x18,0x00}, // !
    {0x6C,0x6C,0x6C,0x00,0x00,0x00,0x00,0x00}, // "
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    {0x00,0x00,0xFE,0x8C,0x18,0x32,0xFE,0x00}  // z
};

#include "esp_lcd_types.h"

/* ============================================================
   FRAMEBUFFER DMA ÔÇö 128 x 160 x 2 bytes = 40 KB
   ============================================================ */
static uint16_t *s_fb = NULL;

static inline uint16_t rgb888_to_rgb565(uint8_t r, uint8_t g, uint8_t b) {
    uint16_t color = (uint16_t)(((r & 0xF8) << 8) | ((g & 0xFC) << 3) | (b >> 3));
    return (uint16_t)((color << 8) | (color >> 8));
}

static inline void fb_set_pixel(int x, int y, uint16_t color) {
    if (x >= 0 && x < LCD_WIDTH && y >= 0 && y < LCD_HEIGHT) {
        s_fb[y * LCD_WIDTH + x] = color;
    }
}

void fb_clear(uint16_t color) {
    for (int i = 0; i < LCD_WIDTH * LCD_HEIGHT; i++) {
        s_fb[i] = color;
    }
}

void fb_fill_rect(int x, int y, int w, int h, uint16_t color) {
    if (x < 0) { w += x; x = 0; }
    if (y < 0) { h += y; y = 0; }
    if (x + w > LCD_WIDTH)  w = LCD_WIDTH - x;
    if (y + h > LCD_HEIGHT) h = LCD_HEIGHT - y;
    if (w <= 0 || h <= 0) return;

    for (int row = y; row < y + h; row++) {
        for (int col = x; col < x + w; col++) {
            s_fb[row * LCD_WIDTH + col] = color;
        }
    }
}

void fb_draw_char(int x, int y, char c, uint16_t fg_color, uint16_t bg_color) {
    if (c < 32 || c > 122) c = '?';
    uint8_t c_idx = c - 32;
    for (int row = 0; row < 8; row++) {
        uint8_t bits = font8x8[c_idx][row];
        for (int col = 0; col < 8; col++) {
            fb_set_pixel(x + col, y + row,
                (bits & (1 << (7 - col))) ? fg_color : bg_color);
        }
    }
}

void fb_draw_string(int x, int y, const char *str, uint16_t fg_color, uint16_t bg_color) {
    while (*str) {
        fb_draw_char(x, y, *str++, fg_color, bg_color);
        x += 8;
        if (x + 8 > LCD_WIDTH) break;
    }
}

void fb_flush(void) {
    esp_lcd_panel_draw_bitmap(panel_handle, 0, 0, LCD_WIDTH, LCD_HEIGHT, s_fb);
}

/* ============================================================
   Frecventa 802.15.4: CH11=2405MHz ... CH26=2480MHz
   ============================================================ */
static inline uint16_t channel_to_mhz(uint8_t ch) {
    return (uint16_t)(2405 + (ch - 11) * 5);
}

/* ============================================================
   Callback IEEE 802.15.4 RX ÔÇö IRAM_ATTR (ISR-safe)
   FOARTE IMPORTANT: apelam esp_ieee802154_receive_handle_done()
   pentru a returna bufferul RX catre driver.
   ============================================================ */
void IRAM_ATTR esp_ieee802154_receive_done(
    uint8_t *frame,
    esp_ieee802154_frame_info_t *frame_info)
{
    ieee802154_frame_count++;

    last_rssi = frame_info->rssi;
    last_lqi  = frame_info->lqi;
    last_rx_channel = frame_info->channel;

    /* Eliberam bufferul RX catre driver dupa procesare */
    esp_ieee802154_receive_handle_done(frame);
}

/* ============================================================ */
void app_main(void)
{
    /* --- NVS ---------------------------------------------------- */
    esp_err_t ret = nvs_flash_init();
    if (ret == ESP_ERR_NVS_NO_FREE_PAGES || ret == ESP_ERR_NVS_NEW_VERSION_FOUND) {
        ESP_ERROR_CHECK(nvs_flash_erase());
        ret = nvs_flash_init();
    }
    ESP_ERROR_CHECK(ret);

    /* --- Alocare framebuffer DMA -------------------------------- */
    s_fb = (uint16_t *)heap_caps_malloc(
        LCD_WIDTH * LCD_HEIGHT * sizeof(uint16_t),
        MALLOC_CAP_DMA);
    if (!s_fb) {
        ESP_LOGE(TAG, "Eroare alocare framebuffer DMA!");
        return;
    }

    /* --- SPI bus ------------------------------------------------ */
    spi_bus_config_t buscfg = {
        .sclk_io_num = TFT_SCLK,
        .mosi_io_num = TFT_MOSI,
        .miso_io_num = -1,
        .quadwp_io_num = -1,
        .quadhd_io_num = -1,
        .max_transfer_sz = LCD_WIDTH * LCD_HEIGHT * sizeof(uint16_t),
    };
    ESP_ERROR_CHECK(spi_bus_initialize(SPI2_HOST, &buscfg, SPI_DMA_CH_AUTO));

    /* --- Panel IO ----------------------------------------------- */
    esp_lcd_panel_io_handle_t io_handle = NULL;
    esp_lcd_panel_io_spi_config_t io_config = {
        .dc_gpio_num = TFT_DC,
        .cs_gpio_num = TFT_CS,
        .pclk_hz = 2 * 1000 * 1000,   // 2 MHz ÔÇö conservator, stabil
        .lcd_cmd_bits = 8,
        .lcd_param_bits = 8,
        .spi_mode = 0,
        .trans_queue_depth = 7,
    };
    ESP_ERROR_CHECK(esp_lcd_new_panel_io_spi(
        (esp_lcd_spi_bus_handle_t)SPI2_HOST, &io_config, &io_handle));

    /* --- Panel init --------------------------------------------- */
    esp_lcd_panel_dev_config_t panel_config = {
        .reset_gpio_num = TFT_RST,
        .bits_per_pixel = 16,
    };
    ESP_ERROR_CHECK(esp_lcd_new_panel_st7735(io_handle, &panel_config, &panel_handle));
    ESP_ERROR_CHECK(esp_lcd_panel_reset(panel_handle));
    ESP_ERROR_CHECK(esp_lcd_panel_init(panel_handle));

    vTaskDelay(pdMS_TO_TICKS(120));   // ST7735 iese din Sleep Out

    /* --- Offset & orientare -------------------------------------
       Daca textul e rasturnat / oglinzit / decalat, modifica aici.
       Valori comune: set_gap(0,0), (2,1), (2,3), (0,32)
       --- Orientare & offset -------------------------------------
       Daca textul e rasturnat / oglinzit / decalat,
       modifica aici. Valori comune pentru ST7735 128x160:
       - set_gap(0, 0)   -> majoritatea modulelor noi
       - set_gap(2, 1)   -> "Green Tab" vechi
       - set_gap(2, 3)   -> alte clone
       - set_gap(0, 32)  -> unele variante 160x128

       Pentru MADCTL (comanda 0x36), daca e necesar:
       0x00 = normal, 0xC0 = rotit 180, 0xC8 = oglinda+rotit
       ---------------------------------------------------------- */
    esp_lcd_panel_set_gap(panel_handle, 0, 0);
    // Decomenteaza DOAR daca imaginea e rasturnata:
    esp_lcd_panel_io_tx_param(io_handle, 0x36, (uint8_t[]){0xC0}, 1);
    
    ESP_ERROR_CHECK(esp_lcd_panel_invert_color(panel_handle, false));
    ESP_ERROR_CHECK(esp_lcd_panel_disp_on_off(panel_handle, true));
    vTaskDelay(pdMS_TO_TICKS(50));

    /* --- Culori ------------------------------------------------- */
    uint16_t c_black  = rgb888_to_rgb565(0,   0,   0);
    uint16_t c_white  = rgb888_to_rgb565(255, 255, 255);
    uint16_t c_green  = rgb888_to_rgb565(0,   255, 0);
    uint16_t c_yellow = rgb888_to_rgb565(255, 255, 0);
    uint16_t c_red    = rgb888_to_rgb565(255, 0,   0);
    uint16_t c_cyan   = rgb888_to_rgb565(0,   255, 255);

    /* --- Frame initial ÔÇö text static ---------------------------- */
    fb_clear(c_black);
    fb_draw_string(4, 4,  "ZIGBEE TESTER",      c_yellow, c_black);
    fb_draw_string(4, 16, "Platforma: XIAO C6", c_white,  c_black);
    fb_draw_string(4, 28, "Driver: ST7735S",    c_white,  c_black);
    fb_draw_string(4, 40, "Mode: SNIFFER",   c_cyan,   c_black);
    fb_flush();

    ESP_LOGI(TAG, "Display initializat. Pornesc radio...");

    /* --- Zigbee sniffer ----------------------------------------- */
    esp_ieee802154_enable();
    esp_ieee802154_set_promiscuous(true);
    esp_ieee802154_set_channel(current_channel);
    esp_ieee802154_receive();

    char buff[32];

    while (1) {
        /* --- Zona dinamica ÔÇö suprascrie cu negru ---------------- */
        fb_fill_rect(4, 56, 120, 8, c_black);
        snprintf(buff, sizeof(buff), "Ch: %d %u MHz",
                 current_channel, channel_to_mhz(current_channel));
        fb_draw_string(4, 56, buff, c_white, c_black);

        fb_fill_rect(4, 68, 120, 8, c_black);
        snprintf(buff, sizeof(buff), "Frames: %lu", ieee802154_frame_count);
        fb_draw_string(4, 68, buff, c_green, c_black);

        fb_fill_rect(4, 80, 120, 8, c_black);
        snprintf(buff, sizeof(buff), "RSSI: %d dBm", last_rssi);
        fb_draw_string(4, 80, buff, c_green, c_black);

        fb_fill_rect(4, 92, 120, 8, c_black);
        snprintf(buff, sizeof(buff), "LQI: %u", last_lqi);
        fb_draw_string(4, 92, buff, c_green, c_black);

        fb_fill_rect(4, 104, 120, 8, c_black);
        snprintf(buff, sizeof(buff), "RX CH: %u", last_rx_channel);
        fb_draw_string(4, 104, buff, c_yellow, c_black);

        /* Trimite TOT ecranul intr-o SINGURA tranzactie SPI */
        fb_flush();

        /* Asteapta 500ms pe acest canal (timp efectiv de sniffing) */
        vTaskDelay(pdMS_TO_TICKS(500));

        /* Hopping: 11 -> 12 -> ... -> 26 -> 11 */
        current_channel++;
        if (current_channel > 26) {
            current_channel = 11;
        }
        ESP_ERROR_CHECK(esp_ieee802154_set_channel(current_channel));
        ESP_ERROR_CHECK(esp_ieee802154_receive());
    }
}


